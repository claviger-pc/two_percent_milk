## config/west.yml
```yaml
manifest:
  remotes:
    - name: zmkfirmware
      url-base: https://github.com/zmkfirmware
    - name: mouse-pr
      url-base: https://github.com/ftc
  projects:
    - name: zmk
      remote: mouse-pr
      revision: mouse-ftc
      import: app/west.yml
  self:
    path: config
```
